/*
 * Copyright (c) 2015-2016, The Linux Foundation. All rights reserved.
 *
 * This program is free software; you can redistribute it and/or modify
 * it under the terms of the GNU General Public License version 2 and
 * only version 2 as published by the Free Software Foundation.
 *
 * This program is distributed in the hope that it will be useful,
 * but WITHOUT ANY WARRANTY; without even the implied warranty of
 * MERCHANTABILITY or FITNESS FOR A PARTICULAR PURPOSE.  See the
 * GNU General Public License for more details.
 */

&qupv3_se14_i2c {
	status = "ok";
	himax-ts@48 {
		status = "okay";
		compatible = "himax,hxcommon";
		reg = <0x48>;
		interrupt-parent = <&tlmm>;
		interrupts = <122 0x02>;
		himax,panel-coords = <0 1080 0 2160>;
		himax,display-coords = <0 1080 0 2160>;
		himax,rst-gpio = <&tlmm 54 0x00>;
		himax,irq-gpio = <&tlmm 122 0x00>;
		report_type = <1>;
	};
};