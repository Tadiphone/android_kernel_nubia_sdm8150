/*
 * Copyright (c) 2018, The Linux Foundation. All rights reserved.
 *
 * This program is free software; you can redistribute it and/or modify
 * it under the terms of the GNU General Public License version 2 and
 * only version 2 as published by the Free Software Foundation.
 *
 * This program is distributed in the hope that it will be useful,
 * but WITHOUT ANY WARRANTY; without even the implied warranty of
 * MERCHANTABILITY or FITNESS FOR A PARTICULAR PURPOSE.  See the
 * GNU General Public License for more details.
 */

qcom,alium_3450mah_nubia_old {
	qcom,profile-revision = <0x18>;
	qcom,max-voltage-uv = <0x432380>;
	qcom,fg-cc-cv-threshold-mv = <0x1126>;
	qcom,nom-batt-capacity-mah = <0xd7a>;
	qcom,fastchg-current-ma = <0x7d0>;
	qcom,jeita-fcc-ranges = <0x00 0x64 0xcf850 0x65 0x1b8 0x1e8480 0x1b9 0x258 0xf4240>;
	qcom,jeita-fv-ranges = <0x00 0x64 0x432380 0x65 0x1b8 0x432380 0x1b9 0x258 0x3e8fa0>;
	qcom,step-chg-ranges = <0x36ee80 0x401640 0x1e8480 0x401a28 0x432380 0x1e8480>;
	qcom,batt-id-kohm = <0x0f>;
	qcom,battery-beta = <0x109a>;
	qcom,therm-room-temp = <0x186a0>;
	qcom,battery-type = "alium_3450mah_nubia_old";
	qcom,therm-coefficients = <0x2318 0xd0c 0xdaf7 0xc556 0x848d>;
	qcom,therm-center-offset = <0x70>;
	qcom,therm-pull-up = <0x64>;
	qcom,rslow-normal-coeffs = <0x87 0xfc 0x42 0x13>;
	qcom,rslow-low-coeffs = <0x94 0x14 0xe3 0xfc>;
	qcom,checksum = <0x9468>;
	qcom,gui-version = "PM855GUI - 1.0.0.13";
	qcom,fg-profile-data = <0x900b2ea 0x43dc1de3 0xe2dc0000 0x68bc078b 0xfc873c95 0x589da480 0x280087fc 0x42136d05 0xd1face07 0x32009deb 0x67ed9cd5 0x640af2d2 0x1fbdf80a 0xfffae2cb 0x60004400 0x48004900 0x3d002200 0x2d003200 0x3c004000 0x40006000 0x36003a00 0x38003a00 0x35006500 0x57644600 0x44004708 0x60005100 0x4f005c08 0x54084700 0x9a206a40 0x55504c10 0x4b00d800 0x2020080d 0xf702cb05 0xe31c300a 0x7c0dc722 0x9b184043 0xf754e903 0x78113e20 0xd2fc0b0b 0xcc05e31c 0xe0f9f805 0x4c0ad917 0x9323d444 0xdb537f12 0x11f5dec 0x1cd299d6 0xd61c6bc3 0x8f0411ba 0x2017d08b 0xc984b39b 0x76a00980 0x7cfabb05 0x46fae105 0xf867e4 0xccebf6c7 0x7eeaf1c4 0x781016f0 0x2dbd4702 0xdb057500 0xce073200 0xf702c703 0xd2040502 0x25024205 0xae030302 0xf3034800 0x3c004a00 0x4e645100 0x50005208 0x53f85000 0x54005f08 0x38084000 0x56285748 0x5d586a0e 0x4b005200 0x66087600 0x78003e00 0x43084f08 0x4c005a20 0x6a484558 0x510e5d00 0x61004e08 0xd800cf20 0xca04cd0a 0x2d0c0c1d 0xb6229744 0x64539018 0x202cb05 0x5a037a10 0x3f0ab020 0x84044003 0x9505e61c 0xa8029e04 0x91038c18 0xe603dc05 0x41037600 0x20200805 0xf702cb05 0xe31c3002 0x7c05c702 0x9b184003 0xf704e903 0x78008c01 0xc000fa00 0x630d0000>;
};