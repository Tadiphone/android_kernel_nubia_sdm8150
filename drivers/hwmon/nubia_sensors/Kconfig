## drivers/hwmon/nubia_sensors/Kconfig
```kconfig
config NUBIA_SENSORS
	tristate "NUBIA SENSORS ON"
	default n
	help
		nubia sensor

config NUBIA_SENSORS_TMD2725
	tristate "support litehole light/prox sensor driver"
	depends on NUBIA_SENSORS
	default n
	help
		nubia ambient&&prox device of tmd2725
```

## drivers/nubia/Kconfig
```kconfig
#
# Nubia drivers configuration
#

config NUBIA_DRIVERS
	bool "NUBIA DRIVERS"
	default y
	help
	  Say Y here if you want to enable NUBIA DRIVERS
	  If unsure, say N.

config NUBIA_FINGERPRINT
	bool "NUBIA_FINGERPRINT"
	default y
	help
	 Say Y here if you have enable NUBIA_FINGERPRINT
	 IF  unsure ,say N

config NUBIA_TOUCH
        bool "NUBIA_TOUCH"
        default y
        help
         Say Y here if you have enable NUBIA_TOUCH
         IF  unsure ,say N

config MACH_NUBIA
    bool "NUBIA device"
    depends on ARCH_QCOM
    help
      Support for Nubia products

config MACH_NUBIA_SM8150
    bool "NUBIA SM8150"
    depends on ARCH_SM8150
    select MACH_NUBIA
    help
      Support for SM8150 Nubia variants

config MACH_NUBIA_TP1803
    bool "NUBIA_TP1803 board"
    select MACH_NUBIA_SM8150
    help
      Support for Nubia Mini 5G variant

source "drivers/nubia/fingerprint/Kconfig"
source "drivers/nubia/touch/Kconfig"
```

## drivers/nubia/fingerprint/sunwave/Kconfig
```kconfig
config NUBIA_SENSORS_FP_SW6161
       tristate "Sunwave Fingerprint"
       default n
       help
          SUNWAVECORP Fingerprint
```

## drivers/nubia/touch/Kconfig
```kconfig
config NUBIA_TOUCHSCREEN_HXCHIPSET
	tristate "NUBIA HIMAX DEVICE"
	default n

source "drivers/nubia/touch/hxchipset/Kconfig"
```
